## curuvar/i2c_slave_test/Kconfig
```kconfig
#
# For a description of the syntax of this configuration file,
# see the file kconfig-language.txt in the NuttX tools repository.
#

config CURUVAR_I2C_SLAVE_TEST
	tristate "Curuvar I2C Slave Test"
	default n

if CURUVAR_I2C_SLAVE_TEST

config CURUVAR_I2C_SLAVE_TEST_PROGNAME
	string "Program Name"
	default "i2c_slave_test"
	---help---
		This is the name of the program that will be used when the NSH ELF
		program is installed.

config CURUVAR_I2C_SLAVE_TEST_PRIORITY
	int "Task Priority"
	default 100

config CURUVAR_I2C_SLAVE_TEST_STACKSIZE
	int "Stack Size"
	default DEFAULT_TASK_STACKSIZE

endif
```

## curuvar/motor_control/Kconfig
```kconfig
#
# For a description of the syntax of this configuration file,
# see the file kconfig-language.txt in the NuttX tools repository.
#

config CURUVAR_MOTOR_CONTROL
	tristate "Curuvar MotorController"
	default n

if CURUVAR_MOTOR_CONTROL

config CURUVAR_MOTOR_CONTROL_PROGNAME
	string "Program Name"
	default "motor_control"
	---help---
		This is the name of the program that will be used when the NSH ELF
		program is installed.

config CURUVAR_MOTOR_CONTROL_PRIORITY
	int "Task Priority"
	default 100

config CURUVAR_MOTOR_CONTROL_STACKSIZE
	int "Stack Size"
	default DEFAULT_TASK_STACKSIZE

endif
```

## curuvar/test_app/Kconfig
```kconfig
#
# For a description of the syntax of this configuration file,
# see the file kconfig-language.txt in the NuttX tools repository.
#

config CURUVAR_TEST_APP
	tristate "Curuvar Test App"
	default n

if CURUVAR_TEST_APP

config CURUVAR_TEST_APP_PROGNAME
	string "Program Name"
	default "test_app"
	---help---
		This is the name of the program that will be used when the NSH ELF
		program is installed.

config CURUVAR_TEST_APP_PRIORITY
	int "Task Priority"
	default 100

config CURUVAR_TEST_APP_STACKSIZE
	int "Stack Size"
	default DEFAULT_TASK_STACKSIZE

endif
```
